/*
 * ST7735 status display for Pico FIDO on ESP32-S3 (80x160 IPS panel).
 *
 * Mirrors the LED state machine (led_get_mode) on screen: READY / PRESS BOOT /
 * WORKING / IDLE. Optional mascot image is drawn at the top when
 * mascot_80x80.h is present (generated by tools/make-lcd-image.py).
 *
 * Panel wiring (Waveshare ESP32-S3-LCD-0.96 style board):
 *   SCLK GPIO10, MOSI GPIO11, CS GPIO12, DC GPIO13, RST GPIO14, SPI2_HOST
 */

#include "fido_status_lcd.h"

#if defined(FIDO_STATUS_LCD)

#include <string.h>
#include <stdbool.h>
#include <stdio.h>
#include "freertos/FreeRTOS.h"
#include "freertos/task.h"
#include "driver/spi_master.h"
#include "driver/gpio.h"
#include "esp_heap_caps.h"
#include "esp_err.h"
#include "esp_log.h"
#include "led/led.h"
#include "font5x7.h"

#if __has_include("mascot_80x80.h")
#include "mascot_80x80.h"
#define HAS_MASCOT 1
#else
#define HAS_MASCOT 0
#endif

#define LCD_W 80
#define LCD_H 160

#ifndef LCD_PIN_SCLK
#define LCD_PIN_SCLK 10
#endif
#ifndef LCD_PIN_MOSI
#define LCD_PIN_MOSI 11
#endif
#ifndef LCD_PIN_CS
#define LCD_PIN_CS 12
#endif
#ifndef LCD_PIN_DC
#define LCD_PIN_DC 13
#endif
#ifndef LCD_PIN_RST
#define LCD_PIN_RST 14
#endif
#ifndef LCD_PIN_BL
#define LCD_PIN_BL -1
#endif

/* Panel offsets/rotation: verified on the 0.96" ST7735 panel (see README). */
#ifndef LCD_X_OFFSET
#define LCD_X_OFFSET 26
#endif
#ifndef LCD_Y_OFFSET
#define LCD_Y_OFFSET 1
#endif
#ifndef LCD_MADCTL
#define LCD_MADCTL 0x08
#endif
#ifndef LCD_INVERT
#define LCD_INVERT 1
#endif

static const char *TAG = "fido_lcd";

static spi_device_handle_t s_spi;
static uint16_t *s_fb;               /* 80*160 RGB565 framebuffer */
static uint8_t s_madctl = LCD_MADCTL;
static int s_xoff = LCD_X_OFFSET;
static int s_yoff = LCD_Y_OFFSET;
static bool s_inv = LCD_INVERT;
static bool s_swap_rb;
static bool s_swap_bytes = true;   /* ST7735 expects MSB first */

static void fb_transform(void) {
    if (!s_fb) {
        return;
    }
    for (int i = 0; i < LCD_W * LCD_H; i++) {
        uint16_t c = s_fb[i];
        if (s_swap_bytes) {
            c = (uint16_t)((c >> 8) | (c << 8));
        }
        if (s_swap_rb) {
            uint16_t r = (c >> 11) & 0x1f;
            uint16_t b = c & 0x1f;
            c = (uint16_t)((c & 0x07e0) | (b << 11) | r);
        }
        s_fb[i] = c;
    }
}

static inline uint16_t rgb(uint8_t r, uint8_t g, uint8_t b) {
    return (uint16_t)(((r & 0xf8) << 8) | ((g & 0xfc) << 3) | (b >> 3));
}

#define COL_BG        rgb(10, 12, 24)
#define COL_BG_SOFT   rgb(18, 22, 40)
#define COL_WHITE     rgb(235, 238, 245)
#define COL_GREY      rgb(120, 126, 145)
#define COL_GREEN     rgb(60, 220, 130)
#define COL_AMBER     rgb(255, 190, 60)
#define COL_BLUE      rgb(90, 170, 255)
#define COL_RED       rgb(235, 80, 90)
#define COL_PURPLE    rgb(160, 120, 240)

/* ---------- low level panel access ---------- */

static void lcd_cmd(uint8_t cmd) {
    gpio_set_level(LCD_PIN_DC, 0);
    spi_transaction_t t = {
        .length = 8 * sizeof(cmd),
        .tx_buffer = &cmd,
    };
    spi_device_polling_transmit(s_spi, &t);
}

static void lcd_data(const uint8_t *data, size_t len) {
    if (len == 0) {
        return;
    }
    gpio_set_level(LCD_PIN_DC, 1);
    spi_transaction_t t = {
        .length = 8 * len,
        .tx_buffer = data,
    };
    spi_device_polling_transmit(s_spi, &t);
}

static void lcd_cmd_data(uint8_t cmd, const uint8_t *data, size_t len) {
    lcd_cmd(cmd);
    lcd_data(data, len);
}

static void lcd_window(int x0, int y0, int x1, int y1) {
    uint8_t tx[4];
    x0 += s_xoff;
    x1 += s_xoff;
    y0 += s_yoff;
    y1 += s_yoff;
    tx[0] = (uint8_t)(x0 >> 8); tx[1] = (uint8_t)x0;
    tx[2] = (uint8_t)(x1 >> 8); tx[3] = (uint8_t)x1;
    lcd_cmd_data(0x2A, tx, sizeof(tx));
    tx[0] = (uint8_t)(y0 >> 8); tx[1] = (uint8_t)y0;
    tx[2] = (uint8_t)(y1 >> 8); tx[3] = (uint8_t)y1;
    lcd_cmd_data(0x2B, tx, sizeof(tx));
    lcd_cmd(0x2C);
}

static void lcd_apply_cfg(void) {
    lcd_cmd(s_inv ? 0x21 : 0x20);
    lcd_cmd_data(0x36, &s_madctl, 1);
}

static void lcd_panel_init(void) {
    gpio_config_t io = {
        .pin_bit_mask = (1ULL << LCD_PIN_DC) | (1ULL << LCD_PIN_RST),
        .mode = GPIO_MODE_OUTPUT,
    };
    gpio_config(&io);
#if LCD_PIN_BL >= 0
    gpio_config_t bl = {
        .pin_bit_mask = (1ULL << LCD_PIN_BL),
        .mode = GPIO_MODE_OUTPUT,
    };
    gpio_config(&bl);
    gpio_set_level(LCD_PIN_BL, 1);
#endif
    gpio_set_level(LCD_PIN_DC, 1);

    gpio_set_level(LCD_PIN_RST, 0);
    vTaskDelay(pdMS_TO_TICKS(30));
    gpio_set_level(LCD_PIN_RST, 1);
    vTaskDelay(pdMS_TO_TICKS(120));

    lcd_cmd(0x01);                       /* software reset */
    vTaskDelay(pdMS_TO_TICKS(150));
    lcd_cmd(0x11);                       /* sleep out */
    vTaskDelay(pdMS_TO_TICKS(120));

    static const uint8_t frmctr[] = {0x05, 0x3C, 0x3C};
    lcd_cmd_data(0xB1, frmctr, sizeof(frmctr));
    lcd_cmd_data(0xB2, frmctr, sizeof(frmctr));
    static const uint8_t frmctr3[] = {0x05, 0x3C, 0x3C, 0x05, 0x3C, 0x3C};
    lcd_cmd_data(0xB3, frmctr3, sizeof(frmctr3));

    static const uint8_t invctr[] = {0x03};
    lcd_cmd_data(0xB4, invctr, sizeof(invctr));

    static const uint8_t pwctr1[] = {0x28, 0x08, 0x04};
    lcd_cmd_data(0xC0, pwctr1, sizeof(pwctr1));
    static const uint8_t pwctr2[] = {0xC0};
    lcd_cmd_data(0xC1, pwctr2, sizeof(pwctr2));
    static const uint8_t pwctr3[] = {0x0D, 0x00};
    lcd_cmd_data(0xC2, pwctr3, sizeof(pwctr3));
    static const uint8_t pwctr4[] = {0x8D, 0x2A};
    lcd_cmd_data(0xC3, pwctr4, sizeof(pwctr4));
    static const uint8_t pwctr5[] = {0x8D, 0xEE};
    lcd_cmd_data(0xC4, pwctr5, sizeof(pwctr5));
    static const uint8_t vmctr1[] = {0x1A};
    lcd_cmd_data(0xC5, vmctr1, sizeof(vmctr1));

    static const uint8_t colmod[] = {0x05};  /* 16 bit RGB565 */
    lcd_cmd_data(0x3A, colmod, sizeof(colmod));

    static const uint8_t caset[] = {0x00, 0x00, 0x00, LCD_W - 1};
    lcd_cmd_data(0x2A, caset, sizeof(caset));
    static const uint8_t raset[] = {0x00, 0x00, 0x00, LCD_H - 1};
    lcd_cmd_data(0x2B, raset, sizeof(raset));

    static const uint8_t gmctrp1[] = {
        0x02, 0x1c, 0x07, 0x12, 0x37, 0x32, 0x29, 0x2d,
        0x29, 0x25, 0x2B, 0x39, 0x00, 0x01, 0x03, 0x10};
    lcd_cmd_data(0xE0, gmctrp1, sizeof(gmctrp1));
    static const uint8_t gmctrn1[] = {
        0x03, 0x1d, 0x07, 0x06, 0x2E, 0x2C, 0x29, 0x2D,
        0x2E, 0x2E, 0x37, 0x3F, 0x00, 0x00, 0x02, 0x10};
    lcd_cmd_data(0xE1, gmctrn1, sizeof(gmctrn1));

    lcd_apply_cfg();

    lcd_cmd(0x13);                       /* normal display mode */
    vTaskDelay(pdMS_TO_TICKS(10));
    lcd_cmd(0x29);                       /* display on */
    vTaskDelay(pdMS_TO_TICKS(50));
}

/* ---------- framebuffer helpers ---------- */

static void fb_fill(uint16_t color) {
    if (!s_fb) {
        return;
    }
    for (int i = 0; i < LCD_W * LCD_H; i++) {
        s_fb[i] = color;
    }
}

static void fb_rect(int x, int y, int w, int h, uint16_t color) {
    if (!s_fb) {
        return;
    }
    if (x < 0) { w += x; x = 0; }
    if (y < 0) { h += y; y = 0; }
    if (x + w > LCD_W) { w = LCD_W - x; }
    if (y + h > LCD_H) { h = LCD_H - y; }
    for (int yy = y; yy < y + h; yy++) {
        uint16_t *row = &s_fb[yy * LCD_W];
        for (int xx = x; xx < x + w; xx++) {
            row[xx] = color;
        }
    }
}

static void fb_frame(int x, int y, int w, int h, int t, uint16_t color) {
    fb_rect(x, y, w, t, color);
    fb_rect(x, y + h - t, w, t, color);
    fb_rect(x, y, t, h, color);
    fb_rect(x + w - t, y, t, h, color);
}

static int text_width(const char *s, int scale) {
    int n = (int)strlen(s);
    return n > 0 ? n * 6 * scale - scale : 0;
}

static void fb_text(int x, int y, const char *s, int scale, uint16_t color) {
    if (!s_fb) {
        return;
    }
    for (const char *p = s; *p; p++) {
        unsigned char c = (unsigned char)*p;
        if (c < FONT5X7_FIRST || c > FONT5X7_LAST) {
            x += 6 * scale;
            continue;
        }
        const uint8_t *g = font5x7[c - FONT5X7_FIRST];
        for (int col = 0; col < 5; col++) {
            for (int row = 0; row < 7; row++) {
                if ((g[col] >> row) & 1) {
                    fb_rect(x + col * scale, y + row * scale, scale, scale, color);
                }
            }
        }
        x += 6 * scale;
    }
}

static void fb_text_center(int y, const char *s, int scale, uint16_t color) {
    int x = (LCD_W - text_width(s, scale)) / 2;
    fb_text(x, y, s, scale, color);
}

#if HAS_MASCOT
static void fb_mascot(int y) {
    int x0 = (LCD_W - MASCOT_W) / 2;
    for (int y0 = 0; y0 < MASCOT_H; y0++) {
        for (int x1 = 0; x1 < MASCOT_W; x1++) {
            int idx = y0 * MASCOT_W + x1;
            if (mascot_mask[idx >> 3] & (0x80 >> (idx & 7))) {
                s_fb[(y + y0) * LCD_W + x0 + x1] = mascot_rgb565[idx];
            }
        }
    }
}
#endif

static void lcd_flush(void) {
    if (!s_fb) {
        return;
    }
    lcd_window(0, 0, LCD_W - 1, LCD_H - 1);
    gpio_set_level(LCD_PIN_DC, 1);
    fb_transform();
    spi_transaction_t t = {
        .length = 8 * LCD_W * LCD_H * sizeof(uint16_t),
        .tx_buffer = s_fb,
    };
    spi_device_polling_transmit(s_spi, &t);
    fb_transform();   /* transforms are self-inverse */
}

/* ---------- screens ---------- */

typedef enum {
    SCREEN_BOOT,
    SCREEN_READY,
    SCREEN_CONFIRM,
    SCREEN_WORKING,
    SCREEN_IDLE,
    SCREEN_LOCKED,
} screen_t;

static screen_t screen_from_led(uint32_t mode) {
    if (mode == MODE_BUTTON) {
        return SCREEN_CONFIRM;
    }
    if (mode == MODE_PROCESSING) {
        return SCREEN_WORKING;
    }
    if (mode == MODE_MOUNTED) {
        return SCREEN_READY;
    }
    if (mode == MODE_SUSPENDED) {
        return SCREEN_IDLE;
    }
    return SCREEN_LOCKED;
}

static void draw_screen(screen_t screen, uint32_t tick) {
    fb_fill(COL_BG);

    uint16_t accent;
    const char *label;
    const char *hint;

    switch (screen) {
        case SCREEN_READY:
            accent = COL_GREEN; label = "READY"; hint = "TAP BOOT TO OK";
            break;
        case SCREEN_CONFIRM:
            accent = COL_AMBER; label = "PRESS"; hint = "BOOT BUTTON";
            break;
        case SCREEN_WORKING:
            accent = COL_BLUE; label = "WORKING"; hint = "DO NOT UNPLUG";
            break;
        case SCREEN_IDLE:
            accent = COL_GREY; label = "IDLE"; hint = "PC CONNECTED";
            break;
        case SCREEN_LOCKED:
            accent = COL_RED; label = "WAIT"; hint = "NO USB LINK";
            break;
        default:
            accent = COL_PURPLE; label = "PICO"; hint = "FIDO";
            break;
    }

#if HAS_MASCOT
    fb_mascot(4);
#else
    /* Simple face placeholder so the panel has visible content without art. */
    fb_rect(22, 26, 36, 36, COL_BG_SOFT);
    fb_rect(30, 38, 6, 6, accent);
    fb_rect(44, 38, 6, 6, accent);
    fb_rect(32, 50, 16, 3, accent);
#endif

    fb_text_center(106, label, 2, accent);
    fb_text_center(128, hint, 1, COL_GREY);

    /* Activity bar: sweeps while working, blinks while waiting for the button. */
    int bar_y = LCD_H - 6;
    uint16_t bar_col = COL_BG_SOFT;
    fb_rect(0, bar_y, LCD_W, 4, bar_col);
    if (screen == SCREEN_WORKING) {
        int pos = (tick / 2) % (LCD_W + 20) - 10;
        fb_rect(pos, bar_y, 20, 4, accent);
    }
    else if (screen == SCREEN_CONFIRM) {
        if ((tick / 5) & 1) {
            fb_frame(0, 0, LCD_W, LCD_H, 3, accent);
        }
    }
    else {
        fb_rect(2, bar_y, (LCD_W - 4), 4, accent);
    }
}


#ifdef LCD_CALIBRATION
/* Candidate panel configurations; confirms MADCTL (orientation + RGB/BGR),
 * offsets and inversion on the real panel. BOOT cycles through them. */
typedef struct {
    uint8_t madctl;
    int8_t xo;
    int8_t yo;
    bool inv;
} lcd_cfg_t;

static const lcd_cfg_t cal_cfgs[] = {
    /* Verified on hardware: BGR panel, byte-swapped 16-bit writes. */
    {0xCC, 26, 1, true},   /* V0: greentab160x80, rotation 0, INVON */
    {0xCC, 24, 0, false},  /* V1: redtab160x80, rotation 0 */
    {0xCC, 24, 0, true},   /* V2 */
    {0xCC, 26, 1, false},  /* V3 */
    {0x08, 26, 1, true},   /* V4: rotation 2 instead of 0 */
    {0x08, 24, 0, false},  /* V5 */
    {0xA8, 1, 26, true},   /* V6: landscape 160x80 greentab */
    {0xA8, 0, 24, false},  /* V7: landscape 160x80 redtab */
    {0x00, 24, 0, true},   /* V8: previous config */
};
#define CAL_COUNT ((int)(sizeof(cal_cfgs) / sizeof(cal_cfgs[0])))

static int s_cal_idx;

static void lcd_apply_index(int idx) {
    s_madctl = cal_cfgs[idx].madctl;
    s_xoff = cal_cfgs[idx].xo;
    s_yoff = cal_cfgs[idx].yo;
    s_inv = cal_cfgs[idx].inv;
    lcd_apply_cfg();
}

static void draw_calibration(void) {
    fb_fill(COL_BG);
    fb_frame(0, 0, LCD_W, LCD_H, 2, COL_WHITE);
    fb_rect(2, 2, 12, 12, COL_RED);
    fb_rect(LCD_W - 14, 2, 12, 12, COL_GREEN);
    fb_rect(2, LCD_H - 14, 12, 12, COL_BLUE);
    fb_rect(LCD_W - 14, LCD_H - 14, 12, 12, COL_WHITE);
    char buf[8];
    snprintf(buf, sizeof(buf), "V%d", s_cal_idx);
    fb_text_center(64, buf, 4, COL_WHITE);
    fb_text_center(104, "BOOT=NEXT", 1, COL_GREY);
    lcd_flush();
}
#endif


#ifdef LCD_COLOR_CAL
typedef struct {
    uint8_t madctl;
    bool inv;
    bool swap_rb;
    bool swap_bytes;
} color_cfg_t;

static const color_cfg_t color_cfgs[] = {
    {0x00, true,  false, false},  /* C0: current defaults */
    {0x00, true,  true,  false},  /* C1: R/B swapped */
    {0x08, true,  false, false},  /* C2: MADCTL BGR bit */
    {0x08, true,  true,  false},  /* C3 */
    {0x00, false, false, false},  /* C4: inversion off */
    {0x00, false, true,  false},  /* C5 */
    {0x08, false, false, false},  /* C6 */
    {0x08, false, true,  false},  /* C7 */
    {0x00, true,  false, true},   /* C8: byte order swapped */
    {0x00, false, false, true},   /* C9 */
};
#define COLOR_CAL_COUNT ((int)(sizeof(color_cfgs) / sizeof(color_cfgs[0])))
static int s_color_idx;

static void color_apply(int idx) {
    const color_cfg_t *c = &color_cfgs[idx];
    s_madctl = c->madctl;
    s_inv = c->inv;
    s_swap_rb = c->swap_rb;
    s_swap_bytes = c->swap_bytes;
    lcd_apply_cfg();
}

static void draw_color_cal(uint32_t tick) {
    draw_screen(SCREEN_READY, tick);
    fb_rect(0, 0, LCD_W, 12, COL_BG_SOFT);
    char buf[8];
    snprintf(buf, sizeof(buf), "C%d", s_color_idx);
    fb_text_center(2, buf, 1, COL_WHITE);
    lcd_flush();
}
#endif

static void lcd_task(void *arg) {
    (void)arg;
    vTaskDelay(pdMS_TO_TICKS(300));
    lcd_panel_init();
#ifdef LCD_COLOR_CAL
    color_apply(0);
    TickType_t last_change = xTaskGetTickCount();
    int last_level = gpio_get_level(0);
    uint32_t tick = 0;
    for (;;) {
        int level = gpio_get_level(0);
        bool pressed = (last_level == 1 && level == 0);
        last_level = level;
        tick++;
        if (pressed || (xTaskGetTickCount() - last_change) > pdMS_TO_TICKS(8000)) {
            s_color_idx = (s_color_idx + 1) % COLOR_CAL_COUNT;
            color_apply(s_color_idx);
            last_change = xTaskGetTickCount();
        }
        draw_color_cal(tick);
        vTaskDelay(pdMS_TO_TICKS(80));
    }
#endif
#ifdef LCD_CALIBRATION
    lcd_apply_index(0);
    draw_calibration();
    TickType_t last_change = xTaskGetTickCount();
    int last_level = gpio_get_level(0);
    for (;;) {
        int level = gpio_get_level(0);
        bool pressed = (last_level == 1 && level == 0);
        last_level = level;
        if (pressed || (xTaskGetTickCount() - last_change) > pdMS_TO_TICKS(8000)) {
            s_cal_idx = (s_cal_idx + 1) % CAL_COUNT;
            lcd_apply_index(s_cal_idx);
            draw_calibration();
            last_change = xTaskGetTickCount();
        }
        vTaskDelay(pdMS_TO_TICKS(25));
    }
#else
    screen_t current = SCREEN_BOOT;
    uint32_t tick = 0;
    draw_screen(current, tick);
    lcd_flush();
    vTaskDelay(pdMS_TO_TICKS(400));

    for (;;) {
        screen_t next = screen_from_led(led_get_mode());
        bool animated = (next == SCREEN_WORKING || next == SCREEN_CONFIRM);
        tick++;
        if (next != current || animated) {
            /* Animate at ~10 fps; full static redraw only on state change. */
            if (next == current && (tick % 5) != 0) {
                vTaskDelay(pdMS_TO_TICKS(20));
                continue;
            }
            current = next;
            draw_screen(current, tick);
            lcd_flush();
        }
        vTaskDelay(pdMS_TO_TICKS(20));
    }
#endif
}

void fido_status_lcd_init(void) {
    spi_bus_config_t bus = {
        .mosi_io_num = LCD_PIN_MOSI,
        .miso_io_num = -1,
        .sclk_io_num = LCD_PIN_SCLK,
        .quadwp_io_num = -1,
        .quadhd_io_num = -1,
        .max_transfer_sz = LCD_W * LCD_H * sizeof(uint16_t) + 64,
    };
    esp_err_t err = spi_bus_initialize(SPI2_HOST, &bus, SPI_DMA_CH_AUTO);
    if (err != ESP_OK) {
        ESP_LOGE(TAG, "spi bus init failed: %s", esp_err_to_name(err));
        return;
    }
    spi_device_interface_config_t dev = {
        .clock_speed_hz = 12 * 1000 * 1000,
        .mode = 0,
        .spics_io_num = LCD_PIN_CS,
        .queue_size = 2,
    };
    err = spi_bus_add_device(SPI2_HOST, &dev, &s_spi);
    if (err != ESP_OK) {
        ESP_LOGE(TAG, "spi add device failed: %s", esp_err_to_name(err));
        return;
    }

#if defined(LCD_CALIBRATION) || defined(LCD_COLOR_CAL)
    gpio_config_t btn = {
        .pin_bit_mask = 1ULL << 0,
        .mode = GPIO_MODE_INPUT,
    };
    gpio_config(&btn);
#endif

    s_fb = (uint16_t *)heap_caps_malloc(LCD_W * LCD_H * sizeof(uint16_t), MALLOC_CAP_INTERNAL | MALLOC_CAP_DMA);
    if (!s_fb) {
        ESP_LOGE(TAG, "framebuffer allocation failed");
        return;
    }

    xTaskCreate(lcd_task, "fido_lcd", 6144, NULL, 2, NULL);
}

#endif /* FIDO_STATUS_LCD */
